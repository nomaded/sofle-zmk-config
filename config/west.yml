## config/west.yml
```yaml
manifest:
  remotes:
    - name: zmkfirmware
      url-base: https://github.com/zmkfirmware
    # Additional modules containing boards/shields/custom code can be listed here as well
    # See https://docs.zephyrproject.org/3.2.0/develop/west/manifest.html#projects
    #
    # Adding support for urob's zmk-helpers
    #- name: urob
    #  url-base: https://github.com/urob
    # Switching my my own fork of urob's zmk-helpers
    - name: nomaded
      url-base: https://github.com/nomaded
    # support nice_oled and nice_epaper
    - name: mctechnology17
      url-base: https://github.com/mctechnology17
  projects:
    - name: zmk
      remote: zmkfirmware
      revision: main
      import: app/west.yml
    - name: zmk-helpers
    # Adding support for urob's zmk-helpers
    # remote: urob
    # revision: main
      remote: nomaded
      revision: main
    # support nice_oled and nice_epaper
    #- name: zmk-nice-oled
    #  remote: mctechnology17
    #  revision: main
  self:
    path: config
```
